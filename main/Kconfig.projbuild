## main/Kconfig.projbuild
```kconfig
menu "WALL-E Reborn"

config WALLE_AP_SSID
    string "Fallback access-point name"
    default "WALL-E-Reborn"

config WALLE_AP_PASSWORD
    string "Fallback access-point password"
    default "walle-reborn"

config WALLE_STATUS_LED_GPIO
    int "Onboard WS2812 status LED pin"
    default 38

config WALLE_SERVO_UART_TX
    int "Serial-servo UART TX pin"
    default 17

config WALLE_SERVO_UART_RX
    int "Serial-servo UART RX pin"
    default 18

config WALLE_MEDIA_UART_TX
    int "ESP32-S3 AI Smart media UART TX pin"
    default 14

config WALLE_MEDIA_UART_RX
    int "ESP32-S3 AI Smart media UART RX pin"
    default 13

config WALLE_LCD_SPI_SCLK
    int "ST7789 SPI clock pin"
    default 8

config WALLE_LCD_SPI_MOSI
    int "ST7789 SPI MOSI/DIN pin"
    default 9

config WALLE_LCD_SPI_CS
    int "ST7789 chip-select pin"
    default 15

config WALLE_LCD_DC
    int "ST7789 data/command pin"
    default 41

config WALLE_LCD_RST
    int "ST7789 reset pin"
    default 42

config WALLE_LCD_BACKLIGHT
    int "ST7789 backlight pin"
    default 2

config WALLE_BUTTON_ENGINEERING
    int "Engineering-mode button pin"
    default 4

config WALLE_LED_ENGINEERING
    int "Engineering LED pin"
    default 5

config WALLE_BUTTON_STOP
    int "STOP button pin"
    default 6

config WALLE_LED_SOLAR
    int "SOLAR power-alive LED pin"
    default 21

config WALLE_BATTERY_ADC_CHANNEL
    int "ADC1 channel number for battery divider"
    range 0 9
    default 0

config WALLE_BATTERY_DIVIDER_RATIO_MILLI
    int "Battery divider ratio x1000 (Vadc/Vbattery)"
    default 248

config WALLE_BATTERY_CELLS
    int "Battery cell count"
    range 3 3
    default 3

config WALLE_MOTOR_LEFT_PWM
    int "Left motor PWM/ESC pin"
    default 10

config WALLE_MOTOR_LEFT_IN1
    int "Left brushed motor IN1"
    default 11

config WALLE_MOTOR_LEFT_IN2
    int "Left brushed motor IN2"
    default 12

config WALLE_MOTOR_RIGHT_PWM
    int "Right motor PWM/ESC pin"
    default 7

config WALLE_MOTOR_RIGHT_IN1
    int "Right brushed motor IN1"
    default 39

config WALLE_MOTOR_RIGHT_IN2
    int "Right brushed motor IN2"
    default 40

endmenu
```

## media_s3_ai_smart/main/Kconfig.projbuild
```kconfig
menu "WALL-E media board"

config MEDIA_UART_TX
    int "UART TX pin to motion S3"
    default 17

config MEDIA_UART_RX
    int "UART RX pin from motion S3"
    default 18

config MEDIA_SD_ENABLE
    bool "Enable microSD mount"
    default n

config MEDIA_SD_MOSI
    int "microSD SPI MOSI pin"
    default 11
    depends on MEDIA_SD_ENABLE

config MEDIA_SD_MISO
    int "microSD SPI MISO pin"
    default 13
    depends on MEDIA_SD_ENABLE

config MEDIA_SD_CLK
    int "microSD SPI CLK pin"
    default 12
    depends on MEDIA_SD_ENABLE

config MEDIA_SD_CS
    int "microSD SPI CS pin"
    default 10
    depends on MEDIA_SD_ENABLE

endmenu
```

## media_s3_ai_smart/sdkconfig.defaults
```kconfig
CONFIG_IDF_TARGET="esp32s3"
CONFIG_PARTITION_TABLE_CUSTOM=y
CONFIG_PARTITION_TABLE_CUSTOM_FILENAME="partitions.csv"
CONFIG_ESPTOOLPY_FLASHSIZE_8MB=y
CONFIG_ESP_MAIN_TASK_STACK_SIZE=8192
CONFIG_ESP_TASK_WDT_EN=y
CONFIG_COMPILER_OPTIMIZATION_SIZE=y
CONFIG_LOG_DEFAULT_LEVEL_WARN=y
CONFIG_MEDIA_UART_TX=17
CONFIG_MEDIA_UART_RX=18
CONFIG_MEDIA_SD_ENABLE=n
```

## sdkconfig.defaults
```kconfig
CONFIG_IDF_TARGET="esp32s3"
CONFIG_ESPTOOLPY_OCT_FLASH=y
CONFIG_ESPTOOLPY_FLASHMODE_OPI=y
CONFIG_ESPTOOLPY_FLASH_SAMPLE_MODE_DTR=y
CONFIG_ESPTOOLPY_FLASHSIZE_32MB=y
CONFIG_SPIRAM=y
CONFIG_SPIRAM_MODE_OCT=y
CONFIG_SPIRAM_SPEED_80M=y
CONFIG_SPIRAM_USE_CAPS_ALLOC=y
CONFIG_PARTITION_TABLE_CUSTOM=y
CONFIG_PARTITION_TABLE_CUSTOM_FILENAME="partitions.csv"
CONFIG_COMPILER_OPTIMIZATION_PERF=y
CONFIG_ESP_MAIN_TASK_STACK_SIZE=6144
CONFIG_ESP_SYSTEM_PANIC_PRINT_REBOOT=y
CONFIG_ESP_COREDUMP_ENABLE_TO_FLASH=y
CONFIG_BOOTLOADER_APP_ROLLBACK_ENABLE=y
CONFIG_HTTPD_WS_SUPPORT=y
CONFIG_FREERTOS_HZ=1000
CONFIG_WALLE_BATTERY_DIVIDER_RATIO_MILLI=248
CONFIG_WALLE_BATTERY_CELLS=3
CONFIG_SECURE_SIGNED_APPS_NO_SECURE_BOOT=y
CONFIG_SECURE_SIGNED_ON_UPDATE_NO_SECURE_BOOT=y
CONFIG_SECURE_SIGNED_APPS_RSA_SCHEME=y
CONFIG_SECURE_BOOT_BUILD_SIGNED_BINARIES=y
CONFIG_SECURE_BOOT_SIGNING_KEY="secure_boot_signing_key.pem"
```
